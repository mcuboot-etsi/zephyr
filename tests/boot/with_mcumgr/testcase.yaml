## tests/boot/with_mcumgr/testcase.yaml
```yaml
common:
  sysbuild: true
  platform_allow:
    - nrf52840dk/nrf52840
    - nrf5340dk/nrf5340/cpuapp
    - nrf54l15pdk/nrf54l15/cpuapp
    - nrf9160dk/nrf9160
    - stm32h573i_dk
  integration_platforms:
    - nrf52840dk/nrf52840
    - stm32h573i_dk
  timeout: 600
  slow: true
tests:
  boot.with_mcumgr.boot_validation.test_load_success:
    tags:
      - pytest
      - mcuboot
      - mcumgr
    harness: pytest
    harness_config:
      pytest_root:
        - "pytest/test_successful_boot.py"
    extra_args:
      - mcuboot_CONFIG_BOOT_SWAP_USING_MOVE=y
  boot.with_mcumgr.boot_validation.test_corrupted_magic:
    tags:
      - pytest
      - mcuboot
      - mcumgr
    harness: pytest
    harness_config:
      pytest_root:
        - "pytest/test_no_bootable_image.py"
    extra_args:
      - mcuboot_CONFIG_BOOT_SWAP_USING_MOVE=y
  boot.with_mcumgr.boot_validation.test_aligned_load_addr:
    tags:
      - pytest
      - mcuboot
      - mcumgr
    harness: pytest
    harness_config:
      pytest_root:
        - "pytest/test_no_bootable_image.py"
    extra_args:
      - mcuboot_CONFIG_BOOT_SWAP_USING_MOVE=y
  boot.with_mcumgr.boot_validation.test_misaligned_load_addr:
    tags:
      - pytest
      - mcuboot
      - mcumgr
    harness: pytest
    harness_config:
      pytest_root:
        - "pytest/test_no_bootable_image.py"
    extra_args:
      - mcuboot_CONFIG_BOOT_SWAP_USING_MOVE=y
  boot.with_mcumgr.boot_validation.test_header_size_too_small:
    tags:
      - pytest
      - mcuboot
      - mcumgr
    harness: pytest
    harness_config:
      pytest_root:
        - "pytest/test_no_bootable_image.py"
    extra_args:
      - mcuboot_CONFIG_BOOT_SWAP_USING_MOVE=y
  boot.with_mcumgr.test_upgrade_move:
    tags:
      - pytest
      - mcuboot
      - mcumgr
    harness: pytest
    harness_config:
      pytest_root:
        - "pytest/test_upgrade_move.py"
    extra_args:
      - mcuboot_CONFIG_BOOT_SWAP_USING_MOVE=y
  boot.with_mcumgr.test_upgrade_scratch:
    tags:
      - pytest
      - mcuboot
      - mcumgr
    harness: pytest
    harness_config:
      pytest_root:
        - "pytest/test_upgrade_scratch.py"
    extra_args:
      - mcuboot_CONFIG_BOOT_SWAP_USING_SCRATCH=y
  boot.with_mcumgr.test_downgrade_prevention:
    tags:
      - pytest
      - mcuboot
      - mcumgr
    harness: pytest
    harness_config:
      pytest_root:
        - "pytest/test_downgrade_prevention.py"
    extra_args:
      - mcuboot_CONFIG_MCUBOOT_DOWNGRADE_PREVENTION=y
    extra_configs:
      - CONFIG_MCUBOOT_IMGTOOL_SIGN_VERSION="1.1.1+1"
```
